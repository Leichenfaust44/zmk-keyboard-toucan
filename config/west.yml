## config/west.yml
```yaml
manifest:
  defaults:
    revision: v0.3
  remotes:
    - name: zmkfirmware
      url-base: https://github.com/zmkfirmware
    - name: urob
      url-base: https://github.com/urob
    - name: petejohanson
      url-base: https://github.com/petejohanson/
    - name: caksoylar
      url-base: https://github.com/caksoylar
    - name: geeksville
      url-base: https://github.com/geeksville
  projects:
    - name: zmk
      remote: zmkfirmware
      revision: v0.3
      import: app/west.yml
    # urob modules (from Piantor config)
    - name: zmk-adaptive-key
      remote: urob
      revision: v0.3
    - name: zmk-auto-layer
      remote: urob
      revision: v0.3
    - name: zmk-leader-key
      remote: urob
      revision: v0.3
    - name: zmk-helpers
      remote: urob
      revision: v0.3
    # Toucan-specific modules
    - name: cirque-input-module
      remote: geeksville
      revision: toucan
    - name: zmk-rgbled-widget
      remote: caksoylar
      revision: v0.3
  self:
    path: config
```
